## microros_ws/main/Kconfig.projbuild
```kconfig
menu "Micro-ROS Configuration"
    config MICROROS_NAMESPACE
        string "micro-ROS node namespace"
        default ""
        help
            Namespace prepended to the node/topic names.
endmenu

menu "Busqueda del agente micro-ROS"

    config AGENTE_AUTO
        bool "Buscar el agente en la red (sin conocer su IP)"
        default y
        help
            Si el agente no responde en MICRO_ROS_AGENT_IP, recorre las direcciones de la
            red /24 de la ESP32 probando el puerto del agente, y usa la primera que
            responde. Al perder el agente vuelve a buscar (la IP de la compu puede cambiar
            al reconectarse al hotspot de la camara).

    config AGENTE_PING_MS
        int "Espera por direccion al buscar (ms)"
        depends on AGENTE_AUTO
        range 20 500
        default 60
        help
            Tiempo que se espera la respuesta de cada IP en la barrida completa (cada intento
            real tarda ~2 veces este valor). En las primeras IP se espera el triple.

    config AGENTE_HOSTS_RAPIDOS
        int "Cantidad de IP a probar primero (desde .2)"
        depends on AGENTE_AUTO
        range 1 50
        default 8
        help
            El DHCP de la camara reparte las IP en orden desde .2, asi que la compu y el
            cuerpo estan en las primeras. Se prueban estas en cada intento (rapido).

    config AGENTE_BARRIDO_CADA
        int "Cada cuantos intentos hacer la barrida completa de la red"
        depends on AGENTE_AUTO
        range 1 100
        default 6
        help
            Si el agente no esta entre las primeras IP, se recorre el resto de la red /24
            (lento, ~25 s) cada tantos intentos.

endmenu

menu "Ultrasonido (HC-SR04)"

    config HCSR04_TRIG_PIN
        int "Pin TRIG"
        range 0 33
        default 4
        help
            Salida del ESP32 hacia TRIG (34-39 son solo entrada). No usar 21/22 (I2C del laser).

    config HCSR04_ECHO_PIN
        int "Pin ECHO"
        range 0 39
        default 34
        help
            Entrada desde ECHO. Con el sensor a 3,3 V va directo. Si se alimenta a 5 V,
            el ECHO sale a 5 V y hace falta divisor resistivo (1k + 2k).

endmenu
```
