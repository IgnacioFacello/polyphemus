## microros_ws/Kconfig.projbuild
```kconfig
menu "Micro-ROS Configuration"
    config MICROROS_NAMESPACE
        string "micro-ROS node namespace"
        default ""
        help
            Namespace prepended to the node/topic names.
endmenu
```

## microros_ws/main/Kconfig.projbuild
```kconfig
menu "Project Configuration"

    orsource "$IDF_PATH/examples/common_components/env_caps/$IDF_TARGET/Kconfig.env_caps"

    config MICROROS_NAMESPACE
        string "Micro-ROS Namespace"
        default "/polyphemus"
        help
            Micro-ROS namespace for the application.

    config I2C_MASTER_SCL
        int "SCL GPIO Num"
        range ENV_GPIO_RANGE_MIN ENV_GPIO_OUT_RANGE_MAX
        default 22
        help
            GPIO number for I2C Master clock line.

    config I2C_MASTER_SDA
        int "SDA GPIO Num"
        range ENV_GPIO_RANGE_MIN ENV_GPIO_OUT_RANGE_MAX
        default 21
        help
            GPIO number for I2C Master data line.

    config I2C_MASTER_FREQUENCY
        int "Master Frequency"
        default 400000
        help
            I2C Speed of Master device.

    config INT_PIN
        int "Pin that wil listen for the IMU interrupt"
        default 0
        help
            I2C Speed of Master device.

    config SAMPLE_RATE
        int "MPU6050 Sample rate"
        default 200
        help
            Sample rate de la mpu.

    config ENABLE_IMU_DEBUG
        int "MPU6050 Debug toggle"
        default 0
        help
            Toggles debug serial message.

endmenu
```
